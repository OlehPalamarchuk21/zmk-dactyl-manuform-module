## boards/shields/dactyl-manuform-5x6/Kconfig.shield
```kconfig
config SHIELD_DACTYL-MANUFORM-5X6_LEFT
    def_bool $(shields_list_contains,dactyl-manuform-5x6_left)

config SHIELD_DACTYL-MANUFORM-5X6_RIGHT
    def_bool $(shields_list_contains,dactyl-manuform-5x6_right)
```

## dts/bindings/behaviors/zmk,behavior-batt-led.yaml
```yaml
description: Show the battery level on the indicator LED

compatible: "zmk,behavior-batt-led"

include: zero_param.yaml
```
