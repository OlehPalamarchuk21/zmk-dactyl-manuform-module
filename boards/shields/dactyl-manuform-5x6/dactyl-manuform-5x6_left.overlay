#include "dactyl-manuform-5x6.dtsi"

// No battery-level LED on the left half: only the right half carries one.
// Without a gpio-leds node here, DACTYL_BATT_LED (depends on
// DT_HAS_GPIO_LEDS_ENABLED) stays off, so src/battery_led.c is not compiled
// into the left build. The &batt_led_show behavior is still compiled on both
// halves (a weak no-op on the left).

&kscan0 {
    col-gpios
        = <&pro_micro 4 GPIO_ACTIVE_HIGH>
        , <&pro_micro 5 GPIO_ACTIVE_HIGH>
        , <&pro_micro 6 GPIO_ACTIVE_HIGH>
        , <&pro_micro 7 GPIO_ACTIVE_HIGH>
        , <&pro_micro 8 GPIO_ACTIVE_HIGH>
        , <&pro_micro 9 GPIO_ACTIVE_HIGH>
        ;
};
