## Kconfig
```kconfig
config DACTYL_BATT_LED
    bool "Green battery-level indicator LED"
    default y
    depends on DT_HAS_GPIO_LEDS_ENABLED
    help
      Blink a single discrete LED to indicate the local battery state of
      charge: 3 blinks = good, 2 = medium, 1 = low, and a repeating blink
      below the critical level. Shown once after boot and on demand via the
      &batt_led_show keymap behavior. Both halves carry their own LED and show
      their own battery; each shield overlay defines a `batt-led` gpio-leds
      node, so this is enabled on both halves.

if DACTYL_BATT_LED

config DACTYL_BATT_LED_LEVEL_HIGH
    int "Battery percentage above which 3 blinks are shown"
    default 80

config DACTYL_BATT_LED_LEVEL_LOW
    int "Battery percentage above which 2 blinks are shown (at or below = 1 blink)"
    default 30

config DACTYL_BATT_LED_LEVEL_CRITICAL
    int "Battery percentage at or below which the low-battery heartbeat runs"
    default 15

config DACTYL_BATT_LED_CRITICAL_INTERVAL_SEC
    int "Seconds between blinks of the critical-battery heartbeat"
    default 30

config DACTYL_BATT_LED_BLINK_MS
    int "LED on/off duration per blink half-step, in milliseconds"
    default 200

endif

DT_COMPAT_DACTYL_BATTERY_NCR18650 := dactyl,battery-ncr18650

config DACTYL_BATTERY_CURVE
    bool "NCR18650B battery sensor (curve-based state of charge)"
    default $(dt_compat_enabled,$(DT_COMPAT_DACTYL_BATTERY_NCR18650))
    select ADC
    depends on SENSOR
    help
      Replace ZMK's zmk,battery-nrf-vddh sensor with one that maps the same VDDH
      reading through a real NCR18650B discharge curve. ZMK's stock conversion is
      a single straight line from 3450 mV (0%) to 4200 mV (100%), which burns a
      third of the scale on the first tenth of the cell's capacity and compresses
      the long 3.9-3.7 V plateau where most of the capacity actually sits.

      Enabled automatically by the `dactyl,battery-ncr18650` node in the shield
      devicetree; set the chosen `zmk,battery` back to `&vbatt` to go back to
      ZMK's mapping.

if DACTYL_BATTERY_CURVE

config DACTYL_BATTERY_HOLD_WHILE_CHARGING
    bool "Hold the last battery level while USB is powered"
    default y
    depends on ZMK_USB
    help
      While USB is connected the VDDH rail is fed from USB through the input
      diode, so the sensor reads the rail (well above 4.2 V) and not the cell -
      every mapping reports 100%. With this enabled the last level measured on
      battery power is reported instead, and a fresh reading resumes on the first
      sample after unplugging.

config DACTYL_BATTERY_CUTOFF
    bool "Soft-off when the cell voltage is too low"
    default y
    depends on ZMK_PM_SOFT_OFF && ZMK_BATTERY_REPORTING
    help
      Protect the bare (unprotected) 18650 cell from deep discharge. After
      DACTYL_BATTERY_CUTOFF_SAMPLES samples in a row below
      DACTYL_BATTERY_CUTOFF_MV on battery power, the board enters ZMK
      soft-off. A key press does not wake it; plug in USB or press reset.
      Needs CONFIG_ZMK_PM_SOFT_OFF=y, and ZMK battery reporting, which takes
      the first sample.

if DACTYL_BATTERY_CUTOFF

config DACTYL_BATTERY_CUTOFF_MV
    int "Cell voltage (mV) below which the board powers off"
    default 3300
    range 2800 4400
    help
      3300 mV is about 4% on the NCR18650B curve. Values above 4200 are only
      useful to test the cutoff with a charged cell.

config DACTYL_BATTERY_CUTOFF_SAMPLES
    int "Low samples in a row before powering off"
    default 3
    range 1 60
    help
      The first low sample comes from ZMK battery reporting (at boot, when
      the keyboard becomes active, and every CONFIG_ZMK_BATTERY_REPORT_INTERVAL
      while it stays active). The cutoff then takes the remaining samples
      itself, 5 s apart, so the default of 3 powers off about 10 s after the
      first low sample. More than one sample protects against a single bad
      reading.

endif

endif
```

## dts/bindings/sensor/dactyl,battery-ncr18650.yaml
```yaml
description: |
  Battery state-of-charge monitoring for a Panasonic NCR18650B cell read through
  the nRF52840 VDDH rail. Same measurement as zmk,battery-nrf-vddh, but mapped
  through the cell's real discharge curve and held while USB powers the rail.

compatible: "dactyl,battery-ncr18650"
```
